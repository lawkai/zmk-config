
/ {
    behaviors {
        csr: ctrl_sqt_return {
            compatible = "zmk,behavior-tap-dance";
            label = "CTRL_SQT_RETURN";
            #binding-cells = <0>;
            bindings = <&mt RIGHT_CONTROL SINGLE_QUOTE>, <&kp RET>;
        };
    };
};