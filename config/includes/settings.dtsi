

&lt {
    tapping-term-ms = <300>;
    quick-tap-ms = <200>;
    flavor = "balanced";
    require-prior-idle-ms = <150>;
};

&sl {
    ignore-modifiers;
};


&caps_word { 
    continue-list = <
        UNDERSCORE MINUS 
        BACKSPACE DELETE 
    >; 
    ignore-modifiers;
};

&num_word {
    layers = <NUM>;
    continue-list = <
        BACKSPACE DELETE DOT COMMA
        SLASH ASTERISK PLUS MINUS EQUAL 
    >;
    ignore-modifiers;  // modifiers don't deactivate the layer
};