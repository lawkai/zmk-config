/*
 * Copyright (c) 2020 The ZMK Contributors
 *
 * SPDX-License-Identifier: MIT
 */
// ZMK includes
#include <behaviors.dtsi>
#include <dt-bindings/zmk/bt.h>
#include <dt-bindings/zmk/outputs.h>


#define BASE 0
#define FN   1
#define NAV  2
#define NUM  3
#define MISC 4
#define XXX &none
#define ___ &trans

// Personal Includes
#include "zmk-helpers/helper.h"
#include "includes/settings.dtsi"
#include "includes/combos.dtsi"
#include "includes/macros.dtsi"
#include "includes/behaviours_mod_morph.dtsi"
#include "includes/behaviours_hold_tap.dtsi"
#include "includes/extra_keys.h"

#define HM_TAPPING_TERM 300
#define HM_TAPPING_TERM_FAST 200
#define HM_PRIOR_IDLE 150
#define HM_QUICK_TAP 200

#define _BT_SEL_KEYS_ &bt BT_SEL 0 &bt BT_SEL 1 &bt BT_SEL 2 &bt BT_SEL 3 &bt BT_SEL 4


#define MAKE_HRM(NAME, HOLD, TAP, TRIGGER_POS) \
    ZMK_HOLD_TAP(NAME, \
        flavor = "balanced"; \
        tapping-term-ms = <HM_TAPPING_TERM>; \
        quick-tap-ms = <HM_QUICK_TAP>; \
        require-prior-idle-ms = <HM_PRIOR_IDLE>; \
        bindings = <HOLD>, <TAP>; \
        hold-trigger-key-positions = <TRIGGER_POS>; \
        hold-trigger-on-release; \
    )


MAKE_HRM(hml, &kp, &kp, KEYS_R KEYS_T)  // left-hand HRMs
MAKE_HRM(hmr, &kp, &kp, KEYS_L KEYS_T)  // right-hand HRMs
MAKE_HRM(hmrsdt, &kp, &semi_dqt, KEYS_L KEYS_T) // right-hand HRM semicolon double quote
// MAKE_HRM(hms, &kp, , KEYS_L KEYS_T) // right-hand HRM semicolon double quote

#define SIMPLE_MORPH(NAME, MOD, BINDING1, BINDING2) \
    ZMK_MOD_MORPH(NAME, \
        mods = <(MOD_L ## MOD|MOD_R ## MOD)>; \
        bindings = <BINDING1>, <BINDING2>; \
    )

SIMPLE_MORPH(lpar_brc, SFT, &kp LPAR, &kp LBRC)
SIMPLE_MORPH(rpar_brc, SFT, &kp RPAR, &kp RBRC)

SIMPLE_MORPH(lt_lbkt, SFT, &kp LT, &kp LBKT)
SIMPLE_MORPH(gt_rbkt, SFT, &kp GT, &kp RBKT)

SIMPLE_MORPH(semi_dqt, SFT, &kp SEMI, &kp DQT)
SIMPLE_MORPH(dot_colon, SFT, &kp DOT, &kp COLON)
SIMPLE_MORPH(comma_sqt, SFT, &kp COMMA, &kp SQT)

ZMK_MACRO(eq_gt,
    wait-ms = <0>;
    tap-ms = <0>;
    bindings = <&kp KP_EQUAL &kp GT>;
)

ZMK_MACRO(lt_eq,
    wait-ms = <0>;
    tap-ms = <0>;
    bindings = <&kp LT &kp KP_EQUAL>;
)

ZMK_MACRO(minus_gt,
    wait-ms = <0>;
    tap-ms = <0>;
    bindings = <&kp KP_MINUS &kp GT>;
)

ZMK_MACRO(lt_minus,
    wait-ms = <0>;
    tap-ms = <0>;
    bindings = <&kp LT &kp KP_MINUS>;
)

// ZMK_TAP_DANCE(td_return,
//    tapping-term-ms = <200>;
//    bindings = <&mm_ret_minus_layer>, <&kp LS(RET)>;
// )


ZMK_LAYER(base, 
//╭──────╮ ╭─────────────┬─────────────┬─────────────┬─────────────┬─────────────╮ ╭──────╮ ╭─────────────┬─────────────┬─────────────┬─────────────┬─────────────╮ ╭──────╮
    X_LT     &kp Q         &kp W         &kp E         &kp R         &kp T           X_MT     &kp Y         &kp U         &kp I         &kp O         &kp P           X_RT
//├──────┤ ├─────────────┼─────────────┼─────────────┼─────────────┼─────────────┤ ├──────┤ ├─────────────┼─────────────┼─────────────┼─────────────┼─────────────┤ ├──────┤
    X_LM     &hml LGUI A   &hml LALT S   &hml LSHFT D  &hml LCTRL F  &kp G           X_MM     &kp H         &hmr LCTRL J  &hmr RSHFT K  &hmr RALT L   &hmrsdt RGUI 0  X_RM
//├──────┤ ├─────────────┼─────────────┼─────────────┼─────────────┼─────────────┤ ├──────┤ ├─────────────┼─────────────┼─────────────┼─────────────┼─────────────┤ ├──────┤
    X_LB     &lt NUM Z     &kp X         &kp C         &kp V         &kp B           X_MB     &kp N         &kp M         &comma_sqt    &dot_colon    &lt NAV FSLH    X_RB
//├──────┤ ╰─────────────┼─────────────┴─────────────┼─────────────┼─────────────┤ ├──────┤ ├─────────────┼─────────────┼─────────────┴───────────────────────────╯ ├──────┤
    X_LH                                               &tab_shft     &spc_minus      X_MH     &ret_eq       &bspc_del                                                 X_RH
//╰──────╯                                           ╰─────────────┴─────────────╯ ╰──────╯ ╰─────────────┴─────────────╯                                           ╰──────╯
)

ZMK_LAYER(fn,
//╭──────╮ ╭─────────────┬─────────────┬─────────────┬─────────────┬─────────────╮ ╭──────╮ ╭─────────────┬─────────────┬─────────────┬─────────────┬─────────────╮ ╭──────╮
    X_LT     &kp F1        &kp F2        &kp F3        &kp F4        &kp F5          X_MT     &kp F6        &kp F7        &kp F8        &kp F9        &kp F10          X_RT
//├──────┤ ├─────────────┼─────────────┼─────────────┼─────────────┼─────────────┤ ├──────┤ ├─────────────┼─────────────┼─────────────┼─────────────┼─────────────┤ ├──────┤
    X_LM     &hml LGUI N1  &hml LALT N2  &hml LSHFT N3 &hml LCTRL N4 &kp N5          X_MM     &kp N6        &hmr RCTRL N7 &hmr RSHFT N8 &hmr RALT N9  &hmr RGUI N0     X_RM
//├──────┤ ├─────────────┼─────────────┼─────────────┼─────────────┼─────────────┤ ├──────┤ ├─────────────┼─────────────┼─────────────┼─────────────┼─────────────┤ ├──────┤
    X_LB     ___           &kp K_CUT     &kp K_COPY    &kp K_PASTE   &kp F11         X_MB     &kp F12       ___           ___           ___           ___             X_RB
//├──────┤ ╰─────────────┼─────────────┴─────────────┼─────────────┼─────────────┤ ├──────┤ ├─────────────┼─────────────┼─────────────┴───────────────────────────╯ ├──────┤
    X_LH                                               ___           ___             X_MH     ___           ___                                                       X_RH
//╰──────╯                                           ╰─────────────┴─────────────╯ ╰──────╯ ╰─────────────┴─────────────╯                                           ╰──────╯
)

ZMK_LAYER(nav,
//╭──────╮ ╭─────────────┬─────────────┬─────────────┬─────────────┬─────────────╮ ╭──────╮ ╭─────────────┬─────────────┬─────────────┬─────────────┬─────────────╮ ╭──────╮
    X_LT     ___           ___           ___           ___           ___             X_MT     ___           ___           &kp UP        ___           ___             X_RT
//├──────┤ ├─────────────┼─────────────┼─────────────┼─────────────┼─────────────┤ ├──────┤ ├─────────────┼─────────────┼─────────────┼─────────────┼─────────────┤ ├──────┤
    X_LM     ___           ___           ___           ___           ___             X_MM     ___           &kp LEFT      &kp DOWN      &kp RIGHT     ___             X_RM
//├──────┤ ├─────────────┼─────────────┼─────────────┼─────────────┼─────────────┤ ├──────┤ ├─────────────┼─────────────┼─────────────┼─────────────┼─────────────┤ ├──────┤
    X_LB     ___           ___           ___           ___           ___             X_MB     ___           ___           ___           ___           ___             X_RB
//├──────┤ ╰─────────────┼─────────────┴─────────────┼─────────────┼─────────────┤ ├──────┤ ├─────────────┼─────────────┼─────────────┴───────────────────────────╯ ├──────┤
    X_LH                                               ___           ___             X_MH     &kp RET       &kp BSPC                                                  X_RH
//╰──────╯                                           ╰─────────────┴─────────────╯ ╰──────╯ ╰─────────────┴─────────────╯                                           ╰──────╯
)

ZMK_LAYER(num,
//╭──────╮ ╭─────────────┬─────────────┬─────────────┬─────────────┬─────────────╮ ╭──────╮ ╭─────────────┬─────────────┬─────────────┬─────────────┬─────────────╮ ╭──────╮
    X_LT     &kp FSLH      &kp N7        &kp N8        &kp N9        &kp MINUS       X_MT     ___           ___           ___           ___           ___             X_RT
//├──────┤ ├─────────────┼─────────────┼─────────────┼─────────────┼─────────────┤ ├──────┤ ├─────────────┼─────────────┼─────────────┼─────────────┼─────────────┤ ├──────┤
    X_LM     &kp STAR      &kp N4        &kp N5        &kp N6        &kp PLUS        X_MM     ___           ___           ___           ___           ___             X_RM
//├──────┤ ├─────────────┼─────────────┼─────────────┼─────────────┼─────────────┤ ├──────┤ ├─────────────┼─────────────┼─────────────┼─────────────┼─────────────┤ ├──────┤
    X_LB     &kp K_CANCEL  &kp N1        &kp N2        &kp N3        &kp EQUAL       X_MB     ___           ___           ___           ___           ___             X_RB
//├──────┤ ╰─────────────┼─────────────┴─────────────┼─────────────┼─────────────┤ ├──────┤ ├─────────────┼─────────────┼─────────────┴───────────────────────────╯ ├──────┤
    X_LH                                               &kp N0        &kp DOT         X_MH     ___           ___                                                       X_RH
//╰──────╯                                           ╰─────────────┴─────────────╯ ╰──────╯ ╰─────────────┴─────────────╯                                           ╰──────╯
)

ZMK_LAYER(misc,
//╭──────╮ ╭─────────────┬─────────────┬─────────────┬─────────────┬─────────────╮ ╭──────╮ ╭─────────────┬─────────────┬─────────────┬─────────────┬─────────────╮ ╭──────╮
    X_LT     ___           ___           ___           ___           &bt BT_CLR      X_MT     ___           ___           ___           ___           ___             X_RT
//├──────┤ ├─────────────┼─────────────┼─────────────┼─────────────┼─────────────┤ ├──────┤ ├─────────────┼─────────────┼─────────────┼─────────────┼─────────────┤ ├──────┤
    X_LM                                _BT_SEL_KEYS_                                X_MM     ___           ___           ___           ___           ___             X_RM
//├──────┤ ├─────────────┼─────────────┼─────────────┼─────────────┼─────────────┤ ├──────┤ ├─────────────┼─────────────┼─────────────┼─────────────┼─────────────┤ ├──────┤
    X_LB     ___           ___           ___           ___           &out OUT_TOG    X_MB     ___           ___           ___           ___           ___             X_RB
//├──────┤ ╰─────────────┼─────────────┴─────────────┼─────────────┼─────────────┤ ├──────┤ ├─────────────┼─────────────┼─────────────┴───────────────────────────╯ ├──────┤
    X_LH                                               ___           ___             X_MH     ___           ___                                                       X_RH
//╰──────╯                                           ╰─────────────┴─────────────╯ ╰──────╯ ╰─────────────┴─────────────╯                                           ╰──────╯
)
